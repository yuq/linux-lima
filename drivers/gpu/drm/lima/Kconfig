## drivers/gpu/drm/lima/Kconfig
```kconfig
# Copyright 2017-2018 Qiang Yu <yuq825@gmail.com>
# SPDX-License-Identifier: MIT

config DRM_LIMA
       tristate "LIMA (DRM support for ARM Mali 400/450 GPU)"
       depends on DRM
       depends on ARM || ARM64 || COMPILE_TEST
       select DRM_SCHED
       select DRM_TTM
       help
         DRM driver for ARM Mali 400/450 GPUs.
```
